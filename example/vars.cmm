// T32_1000002 Mon Mar 16 12:41:02 2020

B::

TOOLBAR   ON
STATUSBAR ON
FramePOS 0.14286 24.0 202. 60.
WinPAGE.RESet

WinPAGE.Create P000
WinCLEAR

WinPOS 149.14 3.5833 74. 26. 0. 1. W002
WinTABS 26. 26.
sYmbol.Browse
WinPAN 0. 82.

WinPOS 4.4286 26.917 67. 26. 13. 1. W003
data.dump v.address("TestVarArray3d[5][5][5]")

WinPOS 80.286 26.667 67. 26. 13. 1. W001
Data.dump v.address("TestVarArrayUint163d") /DIALOG

WinPOS 151.14 8.3333 100. 25. 0. 0. W007
CD.PEDIT D:\elf_addr_dict\example\1.

WinPOS 130.86 22.833 122. 5. 13. 1. W004
WinTABS 14. 19.
Data.Print v.address("TestVarArray3d[5][5][5]")

WinPOS 0.0 0.0 268. 60. 0. 0. W000
Var.Watch

VAR.ADDWATCH TestStruct5Var[1].TestUnionArrayLevel1TypeMem[3].level1_1.level2_1.levle3_1.level4_1.level5_2[1]
VAR.ADDWATCH TestStructVar1.level1_2.level2_2.levle3_2.level4_2.level5_2
VAR.ADDWATCH TestStruct5Var[1].TestUnionArrayLevel1TypeMem[3].level1_2.level2_2.levle3_2.level4_1.level5_2[1]
VAR.ADDWATCH TestStructVar1.level1_1.level2_1.levle3_1.level4_1.level5_1
VAR.ADDWATCH TestStructArrayVar1.level1_2.level2_1.levle3_2.level4_2.Filed1.filed1
VAR.ADDWATCH TestStructArrayVar1.level1_2.level2_1.levle3_2.level4_2.Filed1.filed3
VAR.ADDWATCH TestStructArrayVar1.level1_2.level2_1.levle3_2.level4_2.Filed1.filed2
VAR.ADDWATCH TestStructArrayVar1.level1_2.level2_1.levle3_2.level4_2.Filed1.filed4
VAR.ADDWATCH TestStructVar2.union1
VAR.ADDWATCH TestStructVar2.unionStructl1.level2_1.levle3_2.level4_2.level5_4
VAR.ADDWATCH TestStructArrayVar1.level1_2.level2_1.levle3_2.level4_2.Filed1
VAR.ADDWATCH TestStructArrayVar1
VAR.ADDWATCH TestVarArray1d[5]
VAR.ADDWATCH TestVarArray2d[5][5]
VAR.ADDWATCH TestVarArray3d[5][5][5]
VAR.ADDWATCH TestVarArray3d
VAR.ADDWATCH TestVarArrayUint163d
VAR.ADDWATCH TestVarArrayUint163d[5][5][5]
VAR.ADDWATCH TestStructVar1

WinPAGE.select P000

ENDDO
